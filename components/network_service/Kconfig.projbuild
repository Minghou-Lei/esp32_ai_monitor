## components/network_service/Kconfig.projbuild
```kconfig
menu "AI Monitor Configuration"

    config AI_MONITOR_WIFI_SSID
        string "Wi-Fi SSID"
        default ""
        help
            Wi-Fi SSID used by the monitor terminal in station mode.

    config AI_MONITOR_WIFI_PASSWORD
        string "Wi-Fi password"
        default ""
        help
            Wi-Fi password used by the monitor terminal in station mode.

    config AI_MONITOR_WIFI_HOSTNAME
        string "Wi-Fi hostname"
        default "esp32-ai-monitor"
        help
            Hostname registered on the connected network interface.

    config AI_MONITOR_UI_REFRESH_MS
        int "Wi-Fi detail refresh interval (ms)"
        range 250 5000
        default 1000
        help
            LVGL refresh interval for the on-screen Wi-Fi detail page.

endmenu
```

## sdkconfig.defaults
```kconfig
CONFIG_IDF_TARGET="esp32p4"
CONFIG_ESPTOOLPY_FLASHSIZE_32MB=y
CONFIG_ESPTOOLPY_FLASHSIZE="32MB"
# CONFIG_PARTITION_TABLE_SINGLE_APP_LARGE is not set
CONFIG_PARTITION_TABLE_CUSTOM=y
CONFIG_PARTITION_TABLE_CUSTOM_FILENAME="partitions_32mb_singleapp.csv"
CONFIG_PARTITION_TABLE_FILENAME="partitions_32mb_singleapp.csv"
CONFIG_SPIRAM=y
CONFIG_SPIRAM_MODE_HEX=y
CONFIG_SPIRAM_SPEED_200M=y
# CONFIG_ESP_HOST_WIFI_ENABLED is not set
CONFIG_SLAVE_IDF_TARGET_ESP32C6=y
CONFIG_ESP_HOSTED_CP_TARGET_ESP32C6=y
CONFIG_ESP_HOSTED_P4_DEV_BOARD_FUNC_BOARD=y
CONFIG_ESP_HOSTED_SDIO_HOST_INTERFACE=y
CONFIG_ESP_WIFI_REMOTE_ENABLED=y
CONFIG_ESP_WIFI_REMOTE_LIBRARY_HOSTED=y
CONFIG_ESP_MAIN_TASK_STACK_SIZE=6144
CONFIG_ESP_HOSTED_DFLT_TASK_FROM_SPIRAM=y
# CONFIG_ESP_HOSTED_USE_MEMPOOL is not set
CONFIG_WIFI_RMT_STATIC_RX_BUFFER_NUM=16
CONFIG_WIFI_RMT_DYNAMIC_RX_BUFFER_NUM=64
CONFIG_WIFI_RMT_DYNAMIC_TX_BUFFER_NUM=64
CONFIG_WIFI_RMT_AMPDU_TX_ENABLED=y
CONFIG_WIFI_RMT_TX_BA_WIN=32
CONFIG_WIFI_RMT_AMPDU_RX_ENABLED=y
CONFIG_WIFI_RMT_RX_BA_WIN=32
CONFIG_LWIP_TCP_SND_BUF_DEFAULT=65534
CONFIG_LWIP_TCP_WND_DEFAULT=65534
CONFIG_LWIP_TCP_RECVMBOX_SIZE=64
CONFIG_LWIP_UDP_RECVMBOX_SIZE=64
CONFIG_LWIP_TCPIP_RECVMBOX_SIZE=64
CONFIG_LWIP_TCP_SACK_OUT=y
CONFIG_LV_USE_TINY_TTF=y
```
